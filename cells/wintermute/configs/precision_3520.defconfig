## cells/wintermute/configs/precision_3520.defconfig
```kconfig
CONFIG_VENDOR_DELL=y
CONFIG_BOARD_DELL_PRECISION_3520=y
CONFIG_PAYLOAD_EDK2=y
CONFIG_EDK2_BOOTSPLASH_FILE=""
CONFIG_VGA_BIOS=y
CONFIG_MAINBOARD_USE_LIBGFXINIT=y
CONFIG_CONSOLE_CBMEM=y
CONFIG_CONSOLE_SPI_FLASH=y
CONFIG_DRIVERS_PS2_KEYBOARD=y
# CONFIG_EDK2_SECURE_BOOT_SUPPORT is not set
CONFIG_EDK2_DISABLE_TPM=y
CONFIG_EDK2_CUSTOM_BUILD_PARAMS="--pcd gEfiMdeModulePkgTokenSpaceGuid.PcdPs2KbdExtendedVerification=FALSE"
# CONFIG_EDK2_USE_LVGL_RENDERER is not set
CONFIG_USE_CBFS_FILE_OPTION_BACKEND=y
CONFIG_INTEL_OC_MAILBOX_ENABLE_UNDERVOLTING=y
CONFIG_PCIEXP_HOTPLUG=y
CONFIG_PCIEXP_HOTPLUG_BUSES=32
CONFIG_PCIEXP_HOTPLUG_MEM=0x8000000
```

## cells/wintermute/coreboot/src/mainboard/dell/precision_3520/Kconfig
```kconfig
## SPDX-License-Identifier: GPL-2.0-only

if BOARD_DELL_PRECISION_3520

config BOARD_SPECIFIC_OPTIONS
	def_bool y
	select BOARD_ROMSIZE_KB_16384
	select EC_DELL_MEC5035
	select HAVE_ACPI_TABLES
	select MAINBOARD_HAS_LIBGFXINIT
	select SKYLAKE_SOC_PCH_H
	select SOC_INTEL_KABYLAKE
	select SYSTEM_TYPE_LAPTOP

config MAINBOARD_DIR
	default "dell/precision_3520"

config MAINBOARD_PART_NUMBER
	default "Precision 3520"

# IFD BIOS region 0x750000-0xffffff
config CBFS_SIZE
	default 0x8b0000

config DIMM_MAX
	default 2

config DIMM_SPD_SIZE
	default 512

# deguarded ME does not boot without MFS
config ME_CLEANER_ARGS
	string
	default "-S --whitelist MFS"

endif
```
